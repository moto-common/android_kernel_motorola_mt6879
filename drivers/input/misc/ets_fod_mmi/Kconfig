## drivers/input/misc/ets_fod_mmi/Kconfig
```kconfig
config ETS_FOD_MMI
	tristate "ETS FPS MMI"
	default n
	help
	  Say Y here to build the ETS FPS MMI driver as a module.
	  If unsure, say N.
```

## drivers/input/touchscreen/goodix_berlin_mmi/Kconfig
```kconfig
config MTK_PANEL_NOTIFICATIONS
	bool "MTK Panel Notifications"
	depends on TOUCHSCREEN_GOODIX_BRL_MMI
	default n
	help
	  Say Y here to enable support for MTK panel notifications.
	  If unsure, say N.

config TOUCHSCREEN_GOODIX_BRL_SPI
	bool "Goodix BRL SPI Touchscreen"
	depends on TOUCHSCREEN_GOODIX_BRL_MMI
	default n
	help
	  Say Y here to enable support for Goodix BRL SPI touchscreen.
	  If unsure, say N.

config GTP_FOD
	bool "Goodix FOD Gesture"
	depends on TOUCHSCREEN_GOODIX_BRL_MMI
	default n
	help
	  Say Y here to enable support for Goodix FOD gesture.
	  If unsure, say N.

config GTP_DELAY_RELEASE
	bool "Goodix Delay Release"
	depends on TOUCHSCREEN_GOODIX_BRL_MMI
	default n
	help
	  Say Y here to enable support for Goodix delay release.
	  If unsure, say N.

config GTP_LIMIT_USE_SUPPLIER
	bool "Goodix Limit Use Supplier"
	depends on TOUCHSCREEN_GOODIX_BRL_MMI
	default n
	help
	  Say Y here to enable support for Goodix limit use supplier.
	  If unsure, say N.

config GTP_ENABLE_PM_QOS
	bool "Goodix Enable PM QoS"
	depends on TOUCHSCREEN_GOODIX_BRL_MMI
	default n
	help
	  Say Y here to enable support for Goodix PM QoS.
	  If unsure, say N.

config GOODIX_ESD_ENABLE
	bool "Goodix ESD Enable"
	depends on TOUCHSCREEN_GOODIX_BRL_MMI
	default n
	help
	  Say Y here to enable support for Goodix ESD.
	  If unsure, say N.

config GTP_LAST_TIME
	bool "Goodix Last Time"
	depends on TOUCHSCREEN_GOODIX_BRL_MMI
	default n
	help
	  Say Y here to enable support for Goodix last time.
	  If unsure, say N.

config GTP_DDA_STYLUS
	bool "Goodix DDA Stylus"
	depends on TOUCHSCREEN_GOODIX_BRL_MMI
	default n
	help
	  Say Y here to enable support for Goodix DDA stylus.
	  If unsure, say N.

config GTP_USE_MMI_INFO
	bool "Goodix Use MMI Info"
	depends on TOUCHSCREEN_GOODIX_BRL_MMI
	default n
	help
	  Say Y here to enable support for Goodix use MMI info.
	  If unsure, say N.

config TOUCHSCREEN_GOODIX_BRL_MMI
	tristate "Goodix BRL MMI Touchscreen"
	depends on I2C
	default n
	help
	  Say Y here to build the Goodix BRL MMI touchscreen driver as a module.
	  If unsure, say N.
```

## drivers/misc/mediatek/mmstat/Kconfig
```kconfig
config MMSTAT_TRACER
	tristate "Trace memory status periodically"
	depends on TRACING
	depends on VM_EVENT_COUNTERS
	help
	  Periodic tracing of memory status.

	  Mmstat tracer will track memory usage periodically according to
	  indicated timer interval, which includes meminfo, buddy system,
	  hardware memory(if possible) and process memory.
```

## drivers/power/Kconfig
```kconfig
# SPDX-License-Identifier: GPL-2.0-only
source "drivers/power/reset/Kconfig"
source "drivers/power/supply/Kconfig"
source "drivers/power/bq25980_mmi/Kconfig"
```

## drivers/power/bq25980_mmi/Kconfig
```kconfig
config BQ25980_MMI
	tristate "BQ25980 MMI"
	default n
	help
	  Say Y here to build the BQ25980 MMI driver as a module.
	  If unsure, say N.
```

## sound/soc/codecs/aw882xx_dlkm/Kconfig
```kconfig
config AW_RAMPING_SUPPORT
	bool "AW Ramping Support"
	default n
	help
	  Say Y here to enable support for AW ramping.
	  If unsure, say N.

config SND_SOC_AW882XX
	tristate "AW882XX ALSA SoC Support"
	default n
	depends on I2C
	help
	  Say Y here to enable support for AW882XX ALSA SoC driver.
	  If unsure, say N.
```
